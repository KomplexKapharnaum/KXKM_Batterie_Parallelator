## firmware-idf/components/bmu_rint/Kconfig
```kconfig
menu "BMU Internal Resistance"

    config BMU_RINT_ENABLED
        bool "Enable R_int measurement"
        default y

    config BMU_RINT_PERIODIC_ENABLED
        bool "Enable periodic R_int measurement"
        default y
        depends on BMU_RINT_ENABLED

    config BMU_RINT_PERIOD_MIN
        int "Periodic measurement interval (minutes)"
        default 30
        range 5 1440
        depends on BMU_RINT_PERIODIC_ENABLED

    config BMU_RINT_MIN_CURRENT_MA
        int "Minimum load current for valid measurement (mA)"
        default 500
        range 100 5000
        depends on BMU_RINT_ENABLED

    config BMU_RINT_PULSE_FAST_MS
        int "Delay before V2 read — ohmique (ms)"
        default 100
        range 50 500
        depends on BMU_RINT_ENABLED

    config BMU_RINT_PULSE_TOTAL_MS
        int "Total pulse OFF duration (ms)"
        default 1000
        range 500 5000
        depends on BMU_RINT_ENABLED

    config BMU_RINT_R_MAX_MOHM
        int "Maximum plausible R_int (mohm)"
        default 500
        range 100 2000
        depends on BMU_RINT_ENABLED

    config BMU_RINT_DISPLAY_WARN_MOHM
        int "Display warning threshold (mohm, orange)"
        default 50
        depends on BMU_RINT_ENABLED

    config BMU_RINT_DISPLAY_CRIT_MOHM
        int "Display critical threshold (mohm, red)"
        default 100
        depends on BMU_RINT_ENABLED

    config BMU_RINT_TASK_STACK
        int "Periodic task stack size (bytes)"
        default 4096
        range 2048 8192
        depends on BMU_RINT_PERIODIC_ENABLED

    config BMU_RINT_TASK_PRIORITY
        int "Periodic task priority"
        default 2
        range 1 5
        depends on BMU_RINT_PERIODIC_ENABLED

endmenu
```

## firmware-idf/components/bmu_storage/Kconfig
```kconfig
menu "BMU Storage"
    config BMU_USB_MSC_ENABLED
        bool "Enable USB Mass Storage (TinyUSB MSC)"
        default n
        help
            Expose the internal FAT partition as a USB mass storage
            device. Requires TinyUSB CDC for console (replaces
            USB-Serial/JTAG). Allows editing batteries.cfg from PC.

            WARNING: Changes USB console mode. Flash via UART if needed.
endmenu
```

## firmware-idf/components/bmu_vedirect/Kconfig
```kconfig
menu "BMU VE.Direct (Victron)"
    config BMU_VEDIRECT_ENABLED
        bool "Enable VE.Direct parser"
        default n
    config BMU_VEDIRECT_UART_NUM
        int "UART number (0-2)"
        default 2
        depends on BMU_VEDIRECT_ENABLED
    config BMU_VEDIRECT_TX_GPIO
        int "TX GPIO (BMU to charger, -1 to disable)"
        default -1
        depends on BMU_VEDIRECT_ENABLED
    config BMU_VEDIRECT_RX_GPIO
        int "RX GPIO (charger to BMU)"
        default 21
        depends on BMU_VEDIRECT_ENABLED
    config BMU_VEDIRECT_BAUD
        int "Baud rate"
        default 19200
        depends on BMU_VEDIRECT_ENABLED
endmenu
```

## firmware-idf/components/bmu_web/Kconfig
```kconfig
menu "BMU Web Server"
    config BMU_WEB_ADMIN_TOKEN
        string "Admin token for mutation routes"
        default ""
        help
            Token required for POST /api/battery/switch_on|off.
            Empty = mutations disabled (fail-closed).
    config BMU_WEB_MAX_RATE_SLOTS
        int "Rate limiter slot count"
        default 16
    config BMU_WEB_RATE_MAX_REQUESTS
        int "Max requests per window"
        default 10
    config BMU_WEB_RATE_WINDOW_MS
        int "Rate limit window (ms)"
        default 10000
endmenu
```

## firmware-idf/components/bmu_wifi/Kconfig
```kconfig
menu "BMU WiFi"
    config BMU_WIFI_SSID
        string "WiFi SSID"
        default "KXKM-BMU"
    config BMU_WIFI_PASSWORD
        string "WiFi Password"
        default ""
    config BMU_WIFI_MAX_RETRY
        int "Max reconnect attempts (0=infinite)"
        default 0

    config BMU_WIFI_AP_FALLBACK_ENABLED
        bool "Enable AP fallback when STA fails"
        default y

    config BMU_WIFI_AP_FALLBACK_THRESHOLD
        int "STA failures before AP fallback"
        depends on BMU_WIFI_AP_FALLBACK_ENABLED
        default 5
        range 1 50

    config BMU_WIFI_AP_SSID_PREFIX
        string "AP SSID prefix (suffix = last 4 MAC hex)"
        depends on BMU_WIFI_AP_FALLBACK_ENABLED
        default "KXKM-BMU-"
endmenu
```

## firmware-idf/sdkconfig.defaults
```kconfig
# LVGL heap — 64KB required to avoid crash when creating widgets
# for 8 batteries with RTOS queues + tasks allocated
CONFIG_LV_MEM_SIZE_KILOBYTES=64

# WDT elargi pour display LVGL + bus I2C sous charge
CONFIG_ESP_TASK_WDT_TIMEOUT_S=15

# BLE NimBLE (requis par bmu_ble / bmu_ble_victron)
CONFIG_BT_ENABLED=y
CONFIG_BT_NIMBLE_ENABLED=y

# Services GATT BMU (3 services : Battery/System/Control)
# main.cpp:520 appelle bmu_ble_set_nb_ina() sans garde → composant requis
CONFIG_BMU_BLE_ENABLED=y

# Version firmware exposée via Kconfig (lue par bmu_ble_system_svc.cpp:99)
CONFIG_APP_PROJECT_VER_FROM_CONFIG=y
CONFIG_APP_PROJECT_VER="2.0.0"

# Flash 16 Mo + table de partitions custom (OTA 2 Mo, spiffs, fatfs)
# sans ça l'app (~1,7 Mo) déborde la partition factory par défaut (1 Mo)
CONFIG_ESPTOOLPY_FLASHSIZE_16MB=y
CONFIG_ESPTOOLPY_FLASHSIZE="16MB"
CONFIG_PARTITION_TABLE_CUSTOM=y
CONFIG_PARTITION_TABLE_CUSTOM_FILENAME="partitions.csv"

# Victron Remote Monitoring + BLE Instant Readout
# (le code bmu_config référence CONFIG_BMU_VRM_PORTAL_ID et
#  CONFIG_BMU_VICTRON_BLE_KEY inconditionnellement)
CONFIG_BMU_VRM_ENABLED=y
CONFIG_BMU_VICTRON_BLE_ENABLED=y
```
