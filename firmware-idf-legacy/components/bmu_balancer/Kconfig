## firmware-idf-legacy/components/bmu_balancer/Kconfig
```kconfig
menu "BMU Soft Balancer"

    config BMU_BALANCER_ENABLED
        bool "Enable soft-balancing"
        default y

    config BMU_BALANCE_HIGH_MV
        int "Seuil haut au-dessus de V_moy pour reduire duty (mV)"
        default 200
        range 50 1000
        depends on BMU_BALANCER_ENABLED

    config BMU_BALANCE_DUTY_ON
        int "Nombre de cycles ON avant un cycle OFF"
        default 3
        range 1 10
        depends on BMU_BALANCER_ENABLED

    config BMU_BALANCE_DUTY_OFF
        int "Nombre de cycles OFF (500ms chacun)"
        default 2
        range 1 6
        depends on BMU_BALANCER_ENABLED
        help
            2 cycles = 1000ms OFF, compatible avec mesure R_int
            (V2 a +100ms, V3 a +1000ms)

    config BMU_BALANCE_MIN_CONNECTED
        int "Minimum batteries connectees pour equilibrer"
        default 3
        range 2 32
        depends on BMU_BALANCER_ENABLED

endmenu
```

## firmware-idf-legacy/components/bmu_config/Kconfig
```kconfig
menu "BMU Protection Config"

    config BMU_MIN_VOLTAGE_MV
        int "Seuil sous-tension (mV)"
        default 24000

    config BMU_MAX_VOLTAGE_MV
        int "Seuil sur-tension (mV)"
        default 30000

    config BMU_MAX_CURRENT_MA
        int "Seuil sur-courant (mA)"
        default 10000

    config BMU_VOLTAGE_DIFF_MV
        int "Tolerance desequilibre (mV)"
        default 1000

    config BMU_RECONNECT_DELAY_MS
        int "Delai reconnexion (ms)"
        default 10000

    config BMU_NB_SWITCH_MAX
        int "Coupures max avant verrouillage"
        default 5

    config BMU_OVERCURRENT_FACTOR
        int "Facteur surcourant critique (x1000)"
        default 2000
        help
            ERROR si |I| > (factor/1000) * max_current. 2.0 = 2000.

    config BMU_LOOP_PERIOD_MS
        int "Periode boucle protection (ms)"
        default 500

    config BMU_DEVICE_NAME
        string "Nom du BMU (identifiant unique par installation)"
        default "kxkm-bmu"
        help
            Nom utilise pour le BLE advertising, le topic MQTT (bmu/{name}/battery/N),
            et le tag InfluxDB. Exemples: gocab, k-led1, k-led2, tender, kryole.

endmenu
```

## firmware-idf-legacy/components/bmu_i2c_bitbang/Kconfig
```kconfig
menu "BMU I2C Bit-bang (Bus 2)"
    config BMU_I2C_BB_ENABLED
        bool "Enable bit-bang I2C bus 2"
        default n
    config BMU_I2C_BB_SDA_GPIO
        int "SDA GPIO"
        default 38
        depends on BMU_I2C_BB_ENABLED
    config BMU_I2C_BB_SCL_GPIO
        int "SCL GPIO"
        default 39
        depends on BMU_I2C_BB_ENABLED
    config BMU_I2C_BB_FREQ_HZ
        int "Frequency (Hz)"
        default 50000
        range 10000 400000
        depends on BMU_I2C_BB_ENABLED
endmenu
```

## firmware-idf-legacy/components/bmu_influx/Kconfig
```kconfig
menu "BMU InfluxDB"
    config BMU_INFLUX_URL
        string "InfluxDB URL"
        default "http://kxkm-ai:8086"
    config BMU_INFLUX_ORG
        string "InfluxDB Organization"
        default "kxkm"
    config BMU_INFLUX_BUCKET
        string "InfluxDB Bucket"
        default "bmu"
    config BMU_INFLUX_TOKEN
        string "InfluxDB API Token"
        default ""
    config BMU_INFLUX_BUFFER_SIZE
        int "Write buffer size (lines)"
        default 20
endmenu
```

## firmware-idf-legacy/components/bmu_soh/Kconfig
```kconfig
menu "BMU SOH Prediction"

    config BMU_SOH_ENABLED
        bool "Enable TFLite Micro SOH prediction"
        default y
        help
            Runs FPNN INT8 model on-device for battery State of Health estimation.
            Requires ~16 KB arena in SRAM. Disable to save memory if SOH is not needed.

    config BMU_SOH_UPDATE_INTERVAL_S
        int "SOH update interval (seconds)"
        default 10
        range 5 300
        depends on BMU_SOH_ENABLED

    config BMU_SOH_ARENA_KB
        int "TFLite arena size (KB)"
        default 16
        range 8 32
        depends on BMU_SOH_ENABLED

endmenu
```

## firmware-idf-legacy/components/bmu_vedirect/Kconfig
```kconfig
menu "BMU VE.Direct (Victron)"
    config BMU_VEDIRECT_ENABLED
        bool "Enable VE.Direct parser"
        default n
    config BMU_VEDIRECT_UART_NUM
        int "UART number (0-2)"
        default 2
        depends on BMU_VEDIRECT_ENABLED
    config BMU_VEDIRECT_TX_GPIO
        int "TX GPIO (BMU to charger, -1 to disable)"
        default -1
        depends on BMU_VEDIRECT_ENABLED
    config BMU_VEDIRECT_RX_GPIO
        int "RX GPIO (charger to BMU)"
        default 21
        depends on BMU_VEDIRECT_ENABLED
    config BMU_VEDIRECT_BAUD
        int "Baud rate"
        default 19200
        depends on BMU_VEDIRECT_ENABLED

    config BMU_VEDIRECT_TASK_STACK
        int "Parser task stack size (bytes)"
        default 4096
        range 2048 8192
        depends on BMU_VEDIRECT_ENABLED

    config BMU_VEDIRECT_TASK_PRIORITY
        int "Parser task priority"
        default 5
        range 1 10
        depends on BMU_VEDIRECT_ENABLED

endmenu
```

## firmware-idf-legacy/components/bmu_vrm/Kconfig
```kconfig
menu "BMU VRM (Victron Remote Monitoring)"
    config BMU_VRM_ENABLED
        bool "Enable VRM publication"
        default n

    config BMU_VRM_PORTAL_ID
        string "VRM Portal ID"
        default "70b3d549969af37b"
        depends on BMU_VRM_ENABLED

    config BMU_VRM_USE_TLS
        bool "Use TLS (port 8883)"
        default y
        depends on BMU_VRM_ENABLED

    config BMU_VRM_PUBLISH_INTERVAL_S
        int "Publish interval (seconds)"
        default 30
        range 10 300
        depends on BMU_VRM_ENABLED

    config BMU_VRM_SOC_V_MIN
        int "SOC 0% voltage (mV)"
        default 24000
        depends on BMU_VRM_ENABLED

    config BMU_VRM_SOC_V_MAX
        int "SOC 100% voltage (mV)"
        default 28800
        depends on BMU_VRM_ENABLED
endmenu
```

## firmware-idf-v2/sdkconfig.defaults
```kconfig
# === Partition layout ===
CONFIG_PARTITION_TABLE_CUSTOM=y
CONFIG_PARTITION_TABLE_CUSTOM_FILENAME="partitions.csv"
CONFIG_PARTITION_TABLE_FILENAME="partitions.csv"

# === Target ESP32-S3 ===
CONFIG_IDF_TARGET="esp32s3"
CONFIG_IDF_TARGET_ESP32S3=y

# === Flash 16 MB (ESP32-S3-BOX-3) ===
CONFIG_ESPTOOLPY_FLASHSIZE_16MB=y
CONFIG_ESPTOOLPY_FLASHSIZE="16MB"

# === PSRAM (ESP32-S3-BOX-3 embed 8MB octal PSRAM) ===
CONFIG_SPIRAM=y
CONFIG_SPIRAM_MODE_OCT=y
CONFIG_SPIRAM_SPEED_80M=y
# PSRAM NE sert PAS de heap general -- reserve a LVGL double-buffer en Phase 17
CONFIG_SPIRAM_USE_MALLOC=n
CONFIG_SPIRAM_USE_CAPS_ALLOC=y

# === LVGL -- memoire statique 64 KiB (idem v1) ===
CONFIG_LV_MEM_SIZE_KILOBYTES=64
CONFIG_LV_FONT_MONTSERRAT_10=y

# === WDT -- tightened vs v1 (15 s -> 3 s) pour detecter pathologies I2C rapidement ===
CONFIG_ESP_TASK_WDT_TIMEOUT_S=3
CONFIG_ESP_TASK_WDT_INIT=y
CONFIG_ESP_TASK_WDT_CHECK_IDLE_TASK_CPU0=y
CONFIG_ESP_TASK_WDT_CHECK_IDLE_TASK_CPU1=y

# === Heap -- internal SRAM only pour Rust core (deterministic latency) ===
# `heap_caps_malloc(size, MALLOC_CAP_INTERNAL | MALLOC_CAP_8BIT)` consomme uniquement SRAM
CONFIG_HEAP_POISONING_COMPREHENSIVE=y
CONFIG_HEAP_USE_HOOKS=y

# === Logging -- INFO niveau pour monitor serie ===
CONFIG_LOG_DEFAULT_LEVEL_INFO=y
CONFIG_LOG_MAXIMUM_LEVEL_DEBUG=y

# === Pro/App CPU -- FreeRTOS Unicore NON, on veut les 2 cores ===
CONFIG_FREERTOS_UNICORE=n
CONFIG_FREERTOS_HZ=1000

# === main_task stack -- Rust BmuCore::new() construit sur stack avant Box ===
# BmuCore + sub-engines font plusieurs KiB, le default 3.5 KiB deborde.
CONFIG_ESP_MAIN_TASK_STACK_SIZE=8192

# === FATFS Long File Name -- Phase 15 SD log files type "bmu-YYYYMMDD-HHMMSS-NOSYNC.lp" ===
CONFIG_FATFS_LFN_HEAP=y
CONFIG_FATFS_MAX_LFN=64

# === BLE NimBLE (Phase 18 — read-only GATT) ===
CONFIG_BT_ENABLED=y
CONFIG_BT_NIMBLE_ENABLED=y
CONFIG_BT_BLUEDROID_ENABLED=n
CONFIG_BT_NIMBLE_MAX_CONNECTIONS=4
CONFIG_BT_NIMBLE_ROLE_PERIPHERAL=y
CONFIG_BT_NIMBLE_ROLE_CENTRAL=n
CONFIG_BT_NIMBLE_ROLE_BROADCASTER=y
CONFIG_BT_NIMBLE_ROLE_OBSERVER=n
CONFIG_BT_NIMBLE_NVS_PERSIST=y
```

## firmware-idf/components/bmu_ble/Kconfig
```kconfig
menu "BMU Bluetooth"
    config BMU_BLE_ENABLED
        bool "Enable Bluetooth BLE"
        default n
        help
            Active le stack NimBLE BLE pour monitoring et controle via GATT.
            Impact memoire : ~60 KB flash + ~10 KB RAM.

    config BMU_BLE_DEVICE_NAME
        string "BLE device name"
        default "KXKM-BMU"
        depends on BMU_BLE_ENABLED
        help
            Nom visible lors du scan BLE (advertising data).

    config BMU_BLE_MAX_CONNECTIONS
        int "Max simultaneous BLE connections"
        default 3
        range 1 5
        depends on BMU_BLE_ENABLED
        help
            Nombre max de clients BLE connectes simultanement.

    config BMU_BLE_SOH_ENABLED
        bool "Enable BLE SOH characteristic"
        default y
        depends on BMU_BLE_ENABLED
        depends on BMU_RINT_ENABLED
        help
            Expose SOH and R_int summary via BLE characteristic 0x003A.
            Requires bmu_soh and bmu_rint components.
endmenu
```

## firmware-idf/components/bmu_ble_victron/Kconfig
```kconfig
menu "BMU BLE Victron (Instant Readout)"
    config BMU_VICTRON_BLE_ENABLED
        bool "Enable Victron BLE advertising"
        default n
        depends on BT_NIMBLE_ENABLED

    config BMU_VICTRON_BLE_KEY
        string "AES-128 encryption key (32 hex chars)"
        default ""
        depends on BMU_VICTRON_BLE_ENABLED
        help
            Clé AES-128 (32 hex) de l'advertising Victron. Laissée vide par
            défaut (audit H10 : pas de secret commité). À renseigner par
            installation (sdkconfig local / NVS).

    config BMU_VICTRON_ADV_INTERVAL_MS
        int "Advertising slot rotation interval (ms)"
        default 500
        range 200 2000
        depends on BMU_VICTRON_BLE_ENABLED
endmenu
```

## firmware-idf/components/bmu_ble_victron_gatt/Kconfig
```kconfig
menu "BMU Victron GATT SmartShunt"
    config BMU_VICTRON_GATT_ENABLED
        bool "Enable SmartShunt GATT emulation"
        default y
        depends on BT_ENABLED
endmenu
```

## firmware-idf/components/bmu_ble_victron_scan/Kconfig
```kconfig
menu "BMU Victron BLE Scanner"
    config BMU_VIC_SCAN_ENABLED
        bool "Enable Victron BLE device scanner"
        default y
        depends on BT_ENABLED

    config BMU_VIC_SCAN_DURATION_S
        int "Scan duration (seconds)"
        default 5
        range 2 10
        depends on BMU_VIC_SCAN_ENABLED

    config BMU_VIC_SCAN_PERIOD_S
        int "Scan period (seconds between scans)"
        default 30
        range 10 300
        depends on BMU_VIC_SCAN_ENABLED

    config BMU_VIC_SCAN_MAX_DEVICES
        int "Maximum Victron devices to track"
        default 8
        range 1 16
        depends on BMU_VIC_SCAN_ENABLED
endmenu
```

## firmware-idf/components/bmu_config/Kconfig
```kconfig
menu "BMU Protection Config"

    config BMU_MIN_VOLTAGE_MV
        int "Seuil sous-tension (mV)"
        default 24000

    config BMU_MAX_VOLTAGE_MV
        int "Seuil sur-tension (mV)"
        default 30000

    config BMU_MAX_CURRENT_MA
        int "Seuil sur-courant (mA)"
        default 10000

    config BMU_VOLTAGE_DIFF_MV
        int "Tolerance desequilibre (mV)"
        default 1000

    config BMU_RECONNECT_DELAY_MS
        int "Delai reconnexion (ms)"
        default 10000

    config BMU_NB_SWITCH_MAX
        int "Coupures max avant verrouillage"
        default 5

    config BMU_OVERCURRENT_FACTOR
        int "Facteur surcourant critique (x1000)"
        default 1400
        help
            ERROR si |I| > (factor/1000) * max_current. 1.4 = 1400.
            Audit H7 : abaissé de 2.0 à 1.4 pour une coupure ferme plus tôt
            (la fenêtre 1.0×–facteur× n'est que déconnexion réversible).
            Valeur par défaut sûre — à valider selon MOSFET/chimie.

    config BMU_LOOP_PERIOD_MS
        int "Periode boucle protection (ms)"
        default 500

    config BMU_DEVICE_NAME
        string "Nom du BMU (identifiant unique par installation)"
        default "kxkm-bmu"
        help
            Nom utilise pour le BLE advertising, le topic MQTT (bmu/{name}/battery/N),
            et le tag InfluxDB. Exemples: gocab, k-led1, k-led2, tender, kryole.

endmenu
```

## firmware-idf/components/bmu_display/Kconfig
```kconfig
menu "BMU Display"
    config BMU_DISPLAY_BACKLIGHT_GPIO
        int "Backlight GPIO"
        default 47
    config BMU_DISPLAY_BL_DIM_TIMEOUT_S
        int "Backlight dim timeout (seconds, 0=never)"
        default 30
    config BMU_DISPLAY_REFRESH_MS
        int "UI refresh period (ms)"
        default 100
    config BMU_CHART_HISTORY_POINTS
        int "Chart history ring buffer size (points per battery)"
        default 600
        help
            Number of data points kept per battery for the V/I chart.
            At 500ms sampling, 600 = 5 minutes of history.
            Memory cost: 600 * 8 bytes * 16 batteries = 76.8 KB.
endmenu
```

## firmware-idf/components/bmu_i2c_hotplug/Kconfig
```kconfig
menu "BMU I2C Hotplug"

    config BMU_I2C_HOTPLUG_ENABLED
        bool "Enable I2C hotplug (periodic re-scan)"
        default y
        help
            Periodically re-scans the I2C bus to detect added/removed
            INA237 and TCA9535 devices at runtime.

    config BMU_I2C_HOTPLUG_INTERVAL_S
        int "Re-scan interval (seconds)"
        default 10
        range 5 60
        depends on BMU_I2C_HOTPLUG_ENABLED

    config BMU_I2C_HOTPLUG_STACK_SIZE
        int "Task stack size (bytes)"
        default 3072
        depends on BMU_I2C_HOTPLUG_ENABLED

    config BMU_I2C_HOTPLUG_TASK_PRIORITY
        int "Task priority"
        default 3
        depends on BMU_I2C_HOTPLUG_ENABLED

endmenu
```

## firmware-idf/components/bmu_influx/Kconfig
```kconfig
menu "BMU InfluxDB"
    config BMU_INFLUX_DIRECT_ENABLED
        bool "Enable direct InfluxDB writes (line-protocol over HTTP)"
        default n
        help
            Si désactivé (défaut), la télémétrie passe uniquement par MQTT
            (pont Telegraf → InfluxDB). Activez pour conserver l'écriture
            directe firmware → InfluxDB (redondante avec le chemin MQTT,
            mais autonome + persistance offline via bmu_influx_store).

    config BMU_INFLUX_URL
        string "InfluxDB URL"
        default "http://kxkm-ai:8086"
    config BMU_INFLUX_ORG
        string "InfluxDB Organization"
        default "kxkm"
    config BMU_INFLUX_BUCKET
        string "InfluxDB Bucket"
        default "bmu"
    config BMU_INFLUX_TOKEN
        string "InfluxDB API Token"
        default ""
    config BMU_INFLUX_BUFFER_SIZE
        int "Write buffer size (lines)"
        default 20
endmenu
```

## firmware-idf/components/bmu_mqtt/Kconfig
```kconfig
menu "BMU MQTT"
    config BMU_MQTT_BROKER_URI
        string "MQTT Broker URI"
        default "mqtt://kxkm-ai:1883"
        help
            Full URI including protocol. Use mqtts:// for TLS.
    config BMU_MQTT_CLIENT_ID
        string "MQTT Client ID"
        default "kxkm-bmu-01"
    config BMU_MQTT_USERNAME
        string "MQTT Username"
        default ""
    config BMU_MQTT_PASSWORD
        string "MQTT Password"
        default ""
    config BMU_MQTT_RECONNECT_MS
        int "Reconnect delay (ms)"
        default 5000
endmenu
```
